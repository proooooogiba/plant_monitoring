## doc/inc/lst/components/mqtt-connection/Kconfig.projbuild
```kconfig
menu "MQTT Configuration"

    config BROKER_URL
        string "Broker URL"
        default "mqtt://vm4481772.25ssd.had.wf:1883"
        help
            URL of the broker to connect to

    config BROKER_URL_FROM_STDIN
        bool
        default y if BROKER_URL = "FROM_STDIN"

endmenu
```
